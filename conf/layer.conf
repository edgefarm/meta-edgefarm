## conf/layer.conf
```bitbake
# We have a conf and classes directory, add to BBPATH
BBPATH .= ":${LAYERDIR}"

# We have recipes-* directories, add to BBFILES
BBFILES += "${LAYERDIR}/recipes-*/*/*.bb \
            ${LAYERDIR}/recipes-*/*/*.bbappend"

BBFILE_COLLECTIONS += "meta-edgefarm"
BBFILE_PATTERN_meta-edgefarm = "^${LAYERDIR}/"
BBFILE_PRIORITY_meta-edgefarm = "101"

LAYERSERIES_COMPAT_meta-edgefarm = "dunfell"
# Currently there is no dependency to anything, as there are noe repices in here.
LAYERDEPENDS_meta-edgefarm = " "
```

## meta-edgefarm-core/conf/layer.conf
```bitbake
# We have a conf and classes directory, add to BBPATH
BBPATH .= ":${LAYERDIR}"

# We have recipes-* directories, add to BBFILES
BBFILES += "${LAYERDIR}/recipes-*/*/*.bb \
            ${LAYERDIR}/recipes-*/*/*.bbappend"

BBFILE_COLLECTIONS += "meta-edgefarm-core"
BBFILE_PATTERN_meta-edgefarm-core = "^${LAYERDIR}/"
BBFILE_PRIORITY_meta-edgefarm-core = "101"

LAYERSERIES_COMPAT_meta-edgefarm-core = "dunfell"
# Currently there is no dependency to anything, as there are no repices in here.
LAYERDEPENDS_meta-edgefarm-core = " "
```

## meta-edgefarm-devtools/conf/layer.conf
```bitbake
# We have a conf and classes directory, add to BBPATH
BBPATH .= ":${LAYERDIR}"

# We have recipes-* directories, add to BBFILES
BBFILES += "${LAYERDIR}/recipes-*/*/*.bb \
            ${LAYERDIR}/recipes-*/*/*.bbappend"

BBFILE_COLLECTIONS += "meta-edgefarm-devtools"
BBFILE_PATTERN_meta-edgefarm-devtools = "^${LAYERDIR}/"
BBFILE_PRIORITY_meta-edgefarm-devtools = "102"

LAYERSERIES_COMPAT_meta-edgefarm-devtools = "dunfell"
# Currently there is no dependency to anything, as there are noe repices in here.
LAYERDEPENDS_meta-edgefarm-devtools = " "
```

## meta-edgefarm-raspberrypi/conf/layer.conf
```bitbake
# We have a conf and classes directory, add to BBPATH
BBPATH .= ":${LAYERDIR}"

# We have recipes-* directories, add to BBFILES
BBFILES += "${LAYERDIR}/recipes-*/*/*.bb \
            ${LAYERDIR}/recipes-*/*/*.bbappend"

BBFILE_COLLECTIONS += "meta-edgefarm-raspberrypi"
BBFILE_PATTERN_meta-edgefarm-raspberrypi = "^${LAYERDIR}/"
BBFILE_PRIORITY_meta-edgefarm-raspberrypi = "100"

LAYERSERIES_COMPAT_meta-edgefarm-raspberrypi = "dunfell"
# Currently there is no dependency to anything, as there are no repices in here.
LAYERDEPENDS_meta-edgefarm-raspberrypi = ""
```
